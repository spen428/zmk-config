## config/boards/shields/ergotravel_left_standalone/Kconfig.defconfig
```kconfig
if SHIELD_ERGOTRAVEL_LEFT_STANDALONE

config ZMK_KEYBOARD_NAME
	default "Ergotravel LSO"

endif
```

## config/boards/shields/ergotravel_left_standalone/Kconfig.shield
```kconfig
config SHIELD_ERGOTRAVEL_LEFT_STANDALONE
	def_bool $(shields_list_contains,ergotravel_left_standalone)
```

## config/boards/shields/ergotravel_right_standalone/Kconfig.defconfig
```kconfig
if SHIELD_ERGOTRAVEL_RIGHT_STANDALONE

config ZMK_KEYBOARD_NAME
	default "Ergotravel RSO"

endif
```

## config/boards/shields/ergotravel_right_standalone/Kconfig.shield
```kconfig
config SHIELD_ERGOTRAVEL_RIGHT_STANDALONE
	def_bool $(shields_list_contains,ergotravel_right_standalone)
```
